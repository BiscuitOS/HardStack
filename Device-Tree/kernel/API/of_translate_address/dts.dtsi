/*
 * DTS Demo Code
 *
 * (C) 2019.01.06 <buddy.zhang@aliyun.com>
 *
 * This program is free software; you can redistribute it and/or modify
 * it under the terms of the GNU General Public License version 2 as
 * published by the Free Software Foundation.
 */
/ {
	DTS_demo {
		compatible = "DTS_demo, BiscuitOS";
		status = "okay";
		#address-cells = <1>;
		#size-cells = <1>;
		ranges = <0x78000000 0x00000000 0x90000000 0x10000000>;

		child0 {
			reg = <0x80000000 0x20000000
			       0x30000000 0x40000000>;
		};
	};
};
