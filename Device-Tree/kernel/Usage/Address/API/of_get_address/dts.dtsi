/*
 * DTS Demo Code
 *
 * (C) 2019.01.06 <buddy.zhang@aliyun.com>
 *
 * This program is free software; you can redistribute it and/or modify
 * it under the terms of the GNU General Public License version 2 as
 * published by the Free Software Foundation.
 */
/ {
	DTS_demo {
		compatible = "DTS_demo, BiscuitOS";
		status = "okay";
		reg = <0x11223344 0x55667788
		       0x10203040 0x50607080
                       0x99aabbcc 0xddeeff00
		       0x90a0b0c0 0xd0e0f000>;
	};
};
