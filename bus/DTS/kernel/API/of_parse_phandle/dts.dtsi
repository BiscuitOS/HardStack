/*
* DTS Demo Code
*
* (C) 2019.01.06 <buddy.zhang@aliyun.com>
*
* This program is free software; you can redistribute it and/or modify
* it under the terms of the GNU General Public License version 2 as
* published by the Free Software Foundation.
*/
/ {
	DTS_demo {
		compatible = "DTS_demo, BiscuitOS";
		status = "okay";
		phy-handle = <&phy0>;

		phy0: phy@0 {
			compatible = "PHYX, BiscuitOS";
			reg = <0>;
		};

		phy1: phy@1 {
			compatible = "PHY, BiscuitOS";
			reg = <1>;
		};
	};

};
