/*
* DTS Demo Code
*
* (C) 2019.01.06 <buddy.zhang@aliyun.com>
*
* This program is free software; you can redistribute it and/or modify
* it under the terms of the GNU General Public License version 2 as
* published by the Free Software Foundation.
*/
/ {
	DTS_demo {
		compatible = "DTS_demo, BiscuitOS";
		status = "okay";

		DTS_demo_sub0 {
			sub_level = <0x1>;

			DTS_demo_sub1 {
				sub_level = <0x2>;
			};
		};
	};
};
