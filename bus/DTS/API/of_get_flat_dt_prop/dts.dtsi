/*
* DTS Demo Code
*
* (C) 2019.01.06 <buddy.zhang@aliyun.com>
*
* This program is free software; you can redistribute it and/or modify
* it under the terms of the GNU General Public License version 2 as
* published by the Free Software Foundation.
*/
/ {
	BiscuitOS-int = <0x10>;
	BiscuitOS-name = "BiscuitOS";

	DTS_demo {
		compatible = "DTS_demo, BiscuitOS";
		status = "okay";
	};
};
