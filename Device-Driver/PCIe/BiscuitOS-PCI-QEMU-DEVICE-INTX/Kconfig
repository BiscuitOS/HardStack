## Device-Driver/Platform/Common/Attribute/kernel/Kconfig
```kconfig
config BISCUITOS_LDD_PLATFORM_ATTR
	tristate "LDD: Platform Attribute Device Driver"
```

## Device-Driver/Platform/DTS/Resource/kernel/Kconfig
```kconfig
config BISCUITOS_LDD_PLATFORM_RESDTS
	tristate "LDD: Platform Resource with DTS module"
```

## Device-Driver/input/Base/kernel/Kconfig
```kconfig
config BISCUITOS_LDD_INPUT
	select INPUT
	select INPUT_EVDEV
	tristate "LDD: Input Device Driver"
```

## Device-Driver/input/key/kernel/Kconfig
```kconfig
config BISCUITOS_LDD_INPUT_KEY
	select INPUT
	select INPUT_EVDEV
	tristate "LDD: Input Key Device Driver"
```

## Device-Driver/input/touch/kernel/Kconfig
```kconfig
config BISCUITOS_LDD_INPUT_TOUCH
	select INPUT
	select INPUT_EVDEV
	tristate "LDD: Input Touch Device Driver"
```
