## Device-Driver/CMA/Areas/kernel/Kconfig
```kconfig
config BISCUITOS_LDD_CMA
	tristate "LDD: Contiguous Memory allocate from special Areas"
```

## Device-Driver/CMA/Base/kernel/Kconfig
```kconfig
config BISCUITOS_LDD_CMA
	tristate "LDD: Contiguous Memory Allocate Device Driver"
```
